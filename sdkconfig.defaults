## sdkconfig.defaults
```kconfig
# liteArm - ESP32 Configuration

# Target: ESP32-S3 (can also work with ESP32)
CONFIG_IDF_TARGET="esp32s3"

# Flash 2MB + QIO
CONFIG_ESPTOOLPY_FLASHSIZE_2MB=y
CONFIG_ESPTOOLPY_FLASHMODE_QIO=y

# CPU 240MHz
CONFIG_ESP_DEFAULT_CPU_FREQ_MHZ_240=y

# No PSRAM required (but recommended)
# CONFIG_SPIRAM=n

# WiFi memory optimization
CONFIG_ESP_WIFI_STATIC_RX_BUFFER_NUM=2
CONFIG_ESP_WIFI_DYNAMIC_RX_BUFFER_NUM=4
CONFIG_ESP_WIFI_RX_BA_WIN=2
CONFIG_LWIP_TCPIP_RECVMBOX_SIZE=8

# TLS optimization (small buffers)
CONFIG_MBEDTLS_SSL_IN_CONTENT_LEN=8192
CONFIG_MBEDTLS_SSL_OUT_CONTENT_LEN=4096

# WebSocket support
CONFIG_HTTPD_WS_SUPPORT=y

# Custom partition table
CONFIG_PARTITION_TABLE_CUSTOM=y
CONFIG_PARTITION_TABLE_CUSTOM_FILENAME="partitions.csv"

# Console: UART primary
CONFIG_ESP_CONSOLE_UART_DEFAULT=y

# Network hostname
CONFIG_LWIP_LOCAL_HOSTNAME="liteArm"

# SNTP
CONFIG_LWIP_SNTP_UPDATE_DELAY=3600000

# Main task stack
CONFIG_ESP_MAIN_TASK_STACK_SIZE=8192
```
